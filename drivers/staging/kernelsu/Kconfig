## drivers/staging/kernelsu/Kconfig
```kconfig
menu "KernelSU"

config KSU
	bool "KernelSU function support"
	default y
	help
	  Enable kernel-level root privileges on Android System.

config KSU_DEBUG
	bool "KernelSU debug mode"
	depends on KSU
	default n
	help
	  Enable KernelSU debug mode.
	  
config KSU_THRONE_TRACKER_ALWAYS_THREADED
	bool "Always run throne tracker in a kthread"
	default y
	help
	  This option forces throne tracker to run in a kthread even on its first
	  run, which happens at boot time / decryption stage. This can decrease
	  boot time, but can cause crowning failure on some FDE/FBEv1 setups.
	  If you are having issues, say n.   
	  
config KSU_EXTRAS
	bool "Enable custom stuff"
	depends on KSU
	default n
	help
	  Custom extensions. Experimental.
	  Currently, only avc log spoofing is implemented.
	    
config KSU_ALLOWLIST_WORKAROUND
        bool "KernelSU Session Keyring Init workaround"
        depends on KSU
        default y
        help
          Enable session keyring init workaround for problematic devices.
          Useful for situations where the SU allowlist is not kept after a reboot.

config KSU_LSM_SECURITY_HOOKS
	bool "use lsm security hooks"
        depends on KSU
        default n
	help
	  Disabling this is mostly only useful for kernel 4.1 and older.
	  Make sure to implement manual hooks on security/security.c.

endmenu
```
